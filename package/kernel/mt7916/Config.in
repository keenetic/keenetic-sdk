## package/kernel/mt7916/Config.in
```kconfig
if PACKAGE_kmod-mt7916

if TARGET_mt7986

config MT7986_ADIE_MT7975
	bool "MT7986 A-die MT7975"
	default n

endif

if !TARGET_mt7981

config MT7916AN_NIC
	bool "MT7916AN PCIe NIC"
	default n

endif

endif
```

## package/libs/bluedroid/Config.in
```kconfig
config MTK_VENDOR_LIB_HCI_TYPE
	bool "HCI Type Vendor Library"
	default y
	depends on PACKAGE_bluedroid
```

## package/libs/curl/Config.in
```kconfig
if PACKAGE_libcurl

comment "Supported protocols"

config LIBCURL_NGHTTP2
	bool "HTTP2 protocol"
	default n

comment "Miscellaneous"

config LIBCURL_CA
	bool "Enable CA bundle support"
	default n

config LIBCURL_BACKTRACE
	bool "Log a backtrace on a process crash"
	default n

endif
```

## package/libs/openssl/Config.in
```kconfig
menu "Configuration"
	depends on PACKAGE_libopenssl

config OPENSSL_OPTIMIZE_SPEED
	bool
	default n
	prompt "Enable optimization for speed instead of size"

config OPENSSL_TLS13
	bool
	default y
	prompt "Enable TLS13 support"

config OPENSSL_OCSP
	bool
	default y
	prompt "Enable OCSP support"

config OPENSSL_OLD_PROTOS
	bool
	default y
	prompt "Enable SSLv2/SSLv3/TLSv1.1 support"

config OPENSSL_OLD_ALGOS
	bool
	default y
	prompt "Enable DSA/CAST support"

config OPENSSL_ENGINE
	bool "Enable engine support"
	default n

config OPENSSL_ENGINE_BUILTIN
	bool "Build chosen engines into libcrypto"
	depends on OPENSSL_ENGINE
	default y

config OPENSSL_ENGINE_BUILTIN_DEVCRYPTO
	bool
	prompt "Acceleration support through /dev/crypto"
	depends on OPENSSL_ENGINE_BUILTIN

config OPENSSL_WITH_ASYNC
	bool
	prompt "Enable asynchronous jobs support"
	depends on OPENSSL_ENGINE


endmenu
```

## package/libs/zstd/Config.in
```kconfig
menu "Configuration"
	depends on PACKAGE_zstd

config ZSTD_OPTIMIZE_SPEED
	bool "Optimize for speed"
	help
		This enables additional optimization and 
		increases performance considerably at 
		the expense of binary size.

endmenu
```

## target/Config.in
```kconfig
source "tmp/.config-target.in"

# Kernel/Hardware features

config HAS_SPE_FPU
	depends on powerpc
	select HAS_FPU
	bool

config HAS_FPU
	bool

config AUDIO_SUPPORT
	bool

config GPIO_SUPPORT
	bool

config PCI_SUPPORT
	select AUDIO_SUPPORT
	bool

config PCIE_SUPPORT
	bool

config PCMCIA_SUPPORT
	bool

config USB_SUPPORT
	select AUDIO_SUPPORT
	bool

config USB_GADGET_SUPPORT
	bool

config USB_STORAGE_SUPPORT
	bool

config RTC_SUPPORT
	bool

config BIG_ENDIAN
	bool

config USES_INITRAMFS
	bool

config USES_SQUASHFS
	bool

config USES_JFFS2
	bool

config USES_JFFS2_NAND
	bool

config USES_EXT4
	bool

config USES_TARGZ
	bool

config USES_CPIOGZ
	bool

config USES_UBIFS
	bool

config USES_EXTENDED_STORAGE
	bool

config USES_NDW2_WIZARD
	bool

config USES_OLD_MODES
	bool

config IS_EXTENDER
	bool

config OLD_MODEL_1
	bool

config OLD_MODEL_2
	bool

config SYSTEM_MODES
	string
	default "extender" if IS_EXTENDER
	default "ap client repeater router" if USES_OLD_MODES
	default "extender router"

config PROFILE_KCONFIG
	bool

config NO_DPN
	bool

config NO_MMU
	bool

config HAS_BAND_STEERING
	bool

config HAS_BTMTK
	bool

config HAS_MT7603_RADIO
	bool

config HAS_MT7610_RADIO
	bool

config HAS_MT7613_RADIO
	bool

config HAS_MT7615_RADIO
	bool

config HAS_MT7628_RADIO
	bool

config HAS_MT76X2_RADIO
	bool

config HAS_MT7915_RADIO
	bool

config HAS_WHNAT
	bool

config HAS_HWNAT
	bool

config HAS_HWNAT_MIB
	bool

config ARCH_64BIT
	bool

# Architecture selection

config aarch64
	select ARCH_64BIT
	bool

config aarch64_be
	select ARCH_64BIT
	select BIG_ENDIAN
	bool

config arm
	bool

config armeb
	select BIG_ENDIAN
	bool

config i386
	bool

config i686
	bool 

config m68k
	bool

config mips
	select BIG_ENDIAN
	bool

config mipsel
	bool

config mips64
	select BIG_ENDIAN
	select ARCH_64BIT
	bool

config mips64el
	select ARCH_64BIT
	bool

config powerpc
	select BIG_ENDIAN
	bool

config powerpc64
	select BIG_ENDIAN
	select ARCH_64BIT
	bool

config sh3
	bool

config sh3eb
	select BIG_ENDIAN
	bool

config sh4
	bool

config sh4eb
	select BIG_ENDIAN
	bool

config sparc
	select BIG_ENDIAN
	bool

config x86_64
	select ARCH_64BIT
	bool

config ARCH
	string
	default "aarch64"   if aarch64
	default "aarch64_be" if aarch64_be
	default "arm"       if arm
	default "armeb"     if armeb
	default "i386"      if i386
	default "i686"      if i686
	default "m68k"      if m68k
	default "mips"      if mips
	default "mipsel"    if mipsel
	default "mips64"    if mips64
	default "mips64el"  if mips64el
	default "powerpc"   if powerpc
	default "sh3"       if sh3
	default "sh3eb"     if sh3eb
	default "sh4"       if sh4
	default "sh4eb"     if sh4eb
	default "sparc"     if sparc
	default "x86_64"    if x86_64
```

## target/sdk/files/Config.in
```kconfig
config MODULES
	bool
	default y
	option modules

source "tmp/.config-package.in"
```

## toolchain/Config.in
```kconfig
# Copyright (C) 2006-2013 OpenWrt.org
#
# This is free software, licensed under the GNU General Public License v2.
# See /LICENSE for more information.
#

menuconfig TARGET_OPTIONS
	bool "Target Options" if DEVEL

	config TARGET_OPTIMIZATION
		string "Target Optimizations" if TARGET_OPTIONS
		default DEFAULT_TARGET_OPTIMIZATION
		help
		  Optimizations to use when building for the target host.

	config SOFT_FLOAT
		bool "Use software floating point by default" if TARGET_OPTIONS
		default y
		depends on (arm || armeb || powerpc || mipsel || mips) && !HAS_FPU
		help
		  If your target CPU does not have a Floating Point Unit (FPU) or a
		  kernel FPU emulator, but you still wish to support floating point
		  functions, then everything will need to be compiled with soft floating
		  point support (-msoft-float).

		  Most people will answer N.


menuconfig EXTERNAL_TOOLCHAIN
	bool
	prompt "Use external toolchain"  if DEVEL
	help
	  If enabled, OpenWrt will compile using an existing toolchain instead of compiling one

	config NATIVE_TOOLCHAIN
		bool
		prompt "Use host's toolchain"  if DEVEL
		depends on EXTERNAL_TOOLCHAIN
		select NO_STRIP
		help
		  If enabled, OpenWrt will compile using the native toolchain for your host instead of compiling one

	config TARGET_NAME
		string
		prompt "Target name"  if DEVEL
		depends on EXTERNAL_TOOLCHAIN && !NATIVE_TOOLCHAIN
		default "aarch64-unknown-linux-gnu"  if aarch64
		default "aarch64_be-unknown-linux-gnu"  if aarch64_be
		default "arm-unknown-linux-gnu"      if arm
		default "armeb-unknown-linux-gnu"    if armeb
		default "i486-unknown-linux-gnu"     if i386
		default "mips-unknown-linux-gnu"     if mips
		default "mipsel-unknown-linux-gnu"   if mipsel
		default "powerpc-unknown-linux-gnu"  if powerpc
		default "x86_64-unknown-linux-gnu"   if x86_64

	config TOOLCHAIN_URL
		string
		prompt "Toolchain URL" if DEVEL
		depends on EXTERNAL_TOOLCHAIN && !NATIVE_TOOLCHAIN
		help
		  URL of the custom toolchain tarball to download and install.

	config TOOLCHAIN_HASH
		string
		prompt "Toolchain hash" if DEVEL
		depends on EXTERNAL_TOOLCHAIN && !NATIVE_TOOLCHAIN
		help
		  Hash of the custom toolchain tarball.

	config TOOLCHAIN_PREFIX
		string
		prompt "Toolchain prefix"  if DEVEL
		depends on EXTERNAL_TOOLCHAIN && !NATIVE_TOOLCHAIN
		default "aarch64-unknown-linux-gnu"  if aarch64
		default "aarch64_be-unknown-linux-gnu"  if aarch64_be
		default "arm-unknown-linux-gnu-"      if arm
		default "armeb-unknown-linux-gnu-"    if armeb
		default "i486-unknown-linux-gnu-"     if i386
		default "mips-unknown-linux-gnu-"     if mips
		default "mipsel-unknown-linux-gnu-"   if mipsel
		default "powerpc-unknown-linux-gnu-"  if powerpc
		default "x86_64-unknown-linux-gnu-"   if x86_64

	choice TOOLCHAIN_LIBC_TYPE
		prompt "Toolchain libc"  if DEVEL
		depends on EXTERNAL_TOOLCHAIN && !NATIVE_TOOLCHAIN
		default EXTERNAL_TOOLCHAIN_LIBC_USE_UCLIBC
		help
		  Specify the libc type used by the external toolchain. The given value us passed as -m
		  flag to all gcc and g++ invocations. This is mainly intended for multilib toolchains
		  which support glibc and uclibc at the same time. If no value is specified, no -m flag
		  is passed.

		config EXTERNAL_TOOLCHAIN_LIBC_USE_GLIBC
			bool "glibc"
			select USE_GLIBC

		config EXTERNAL_TOOLCHAIN_LIBC_USE_UCLIBC
			bool "uClibc"
			select USE_UCLIBC

		config EXTERNAL_TOOLCHAIN_LIBC_USE_MUSL
			bool "musl"
			select USE_MUSL

	endchoice

	config TOOLCHAIN_LIBC
		string
		depends on EXTERNAL_TOOLCHAIN && !NATIVE_TOOLCHAIN
		default "glibc" if EXTERNAL_TOOLCHAIN_LIBC_USE_GLIBC
		default "uclibc" if EXTERNAL_TOOLCHAIN_LIBC_USE_UCLIBC
		default "musl" if EXTERNAL_TOOLCHAIN_LIBC_USE_MUSL

	config TOOLCHAIN_BIN_PATH
		string
		prompt "Toolchain program path"  if DEVEL
		depends on EXTERNAL_TOOLCHAIN && !NATIVE_TOOLCHAIN
		default "./usr/bin ./bin"
		help
		  Specify additional directories searched for toolchain binaries (override PATH)
		  Use ./DIR for directories relative to the root above

	config TOOLCHAIN_SYSROOT_PATH
		string
		prompt "Toolchain sysroot path" if DEVEL
		depends on EXTERNAL_TOOLCHAIN && !NATIVE_TOOLCHAIN
		default "./sysroot"
		help
		  Specify toolchain sysroot.
		  Use ./DIR for directories relative to the root above

	config TOOLCHAIN_DEBUGROOT_PATH
		string
		prompt "Toolchain debug root path" if DEVEL
		depends on EXTERNAL_TOOLCHAIN && !NATIVE_TOOLCHAIN
		default "./debug-root"
		help
		  Specify toolchain debug root.
		  Use ./DIR for directories relative to the root above

	config TOOLCHAIN_HONOUR_COPTS
		bool
		prompt "Use the option \"-fhonour-copts\"" if DEVEL
		depends on EXTERNAL_TOOLCHAIN && !NATIVE_TOOLCHAIN
		default y

	config TOOLCHAIN_LTO
		bool
		prompt "Use the option \"-flto\"" if DEVEL
		depends on EXTERNAL_TOOLCHAIN && !NATIVE_TOOLCHAIN
		default y

config NEED_TOOLCHAIN
	bool
	depends on DEVEL
	default y if !EXTERNAL_TOOLCHAIN

menuconfig TOOLCHAINOPTS
	bool "Toolchain Options"  if DEVEL
	depends on NEED_TOOLCHAIN

menuconfig EXTRA_TARGET_ARCH
	bool
	prompt "Enable an extra toolchain target architecture" if TOOLCHAINOPTS
	depends on !sparc
	default y	if powerpc64
	default n
	help
	  Some builds may require a 'biarch' toolchain. This option
	  allows you to specify an additional target arch.

	  Most people will answer N here.

	config EXTRA_TARGET_ARCH_NAME
		string
		default "powerpc64"	if powerpc64
		prompt "Extra architecture name" if EXTRA_TARGET_ARCH
		help
		  Specify the cpu name (eg powerpc64 or x86_64) of the
		  additional target architecture.

	config EXTRA_TARGET_ARCH_OPTS
		string
		default "-m64"		if powerpc64
		prompt "Extra architecture compiler options" if EXTRA_TARGET_ARCH
		help
		  If you're specifying an addition target architecture,
		  you'll probably need to also provide options to make
		  the compiler use this alternate arch.

		  For example, if you're building a compiler that can build
		  both powerpc and powerpc64 binaries, you'll need to
		  specify -m64 here.

comment "Binary tools"
	depends on TOOLCHAINOPTS

source "toolchain/binutils/Config.in"

comment "Compiler"
	depends on TOOLCHAINOPTS

source "toolchain/gcc/Config.in"

comment "C Library"
	depends on TOOLCHAINOPTS

choice
	prompt "C Library implementation" if TOOLCHAINOPTS
	default LIBC_USE_UCLIBC
	default LIBC_USE_GLIBC if (aarch64 || aarch64_be)
	help
	  Select the C library implementation.

	config LIBC_USE_GLIBC
		bool "Use (e)glibc"
		select USE_GLIBC
	
	config LIBC_USE_UCLIBC
		select USE_UCLIBC
		bool "Use uClibc"

endchoice

source "toolchain/uClibc/Config.in"

comment "Debuggers"
	depends on TOOLCHAINOPTS

config GDB
	bool
	prompt "Build gdb" if TOOLCHAINOPTS
	default y if !EXTERNAL_TOOLCHAIN
	help
		Enable if you want to build the gdb

config INSIGHT
	bool
	prompt "Build insight-gdb" if TOOLCHAINOPTS
	select GDB
	default n
	help
		Enable if you want to build insight-gdb

config USE_GLIBC
	bool

config USE_MUSL
	bool

config USE_UCLIBC
	bool
	default y if !TOOLCHAINOPTS && !EXTERNAL_TOOLCHAIN && !NATIVE_TOOLCHAIN

config USE_EXTERNAL_LIBC
	bool
	default y if EXTERNAL_TOOLCHAIN || NATIVE_TOOLCHAIN

source "toolchain/gcc/Config.version"

config LIBC
	string
	default "glibc"   if USE_GLIBC
	default "uClibc"  if USE_UCLIBC
	default "musl"    if USE_MUSL

config TARGET_SUFFIX
	string
	default "gnueabi"         if (USE_GLIBC) && (arm || armeb)
	default "gnu"             if (USE_GLIBC) && !(arm || armeb)
	default "uclibcgnueabi"   if USE_UCLIBC && (arm || armeb)
	default "uclibc"          if USE_UCLIBC && !(arm || armeb)
	default "muslgnueabi"     if USE_MUSL && (arm || armeb)
	default "musl"            if USE_MUSL && !(arm || armeb)
```

## toolchain/gcc/Config.in
```kconfig
# Choose gcc version.

choice
	prompt "GCC compiler Version" if TOOLCHAINOPTS
	default GCC_USE_VERSION_4_4_7 if GCC_DEFAULT_VERSION_4_4_7
	default GCC_USE_VERSION_4_6_LINARO
	help
	  Select the version of gcc you wish to use.

	config GCC_USE_VERSION_4_4_7
		select GCC_VERSION_4_4_7
		bool "gcc 4.4.7"

	config GCC_USE_VERSION_4_6_2
		select GCC_VERSION_4_6_2
		bool "gcc 4.6.2"

	config GCC_USE_VERSION_4_7_0
		select GCC_VERSION_4_7_0
		bool "gcc 4.7.0"

	config GCC_USE_VERSION_4_5_LINARO
		select GCC_VERSION_4_5_LINARO
		bool "gcc 4.5.x with Linaro enhancements"

	config GCC_USE_VERSION_4_6_LINARO
		select GCC_VERSION_4_6_LINARO
		bool "gcc 4.6.x with Linaro enhancements"

	config GCC_USE_VERSION_4_7_LINARO
		select GCC_VERSION_4_7_LINARO
		bool "gcc 4.7.x with Linaro enhancements"

	config GCC_USE_VERSION_LLVM
		select GCC_VERSION_LLVM
		bool "llvm-gcc 4.2"
		depends on BROKEN

endchoice

config GCC_USE_GRAPHITE
	bool
	prompt "Compile in support for the new Graphite framework in GCC 4.4+" if TOOLCHAINOPTS
	depends on !GCC_VERSION_LLVM

config GCC_USE_SYSTEM_PPL_CLOOG
	bool
	prompt "Use the system versions of PPL and CLooG"
	depends on GCC_USE_GRAPHITE
	default n

config EXTRA_GCC_CONFIG_OPTIONS
	string
	prompt "Additional gcc configure options" if TOOLCHAINOPTS
	default ""
	help
	    Any additional gcc options you may want to include....

config SSP_SUPPORT
	bool
	prompt "Enable Stack-Smashing Protection support" if TOOLCHAINOPTS
	default y if !PKG_CC_STACKPROTECTOR_NONE
	help
	    Enable Stack-Smashing Protection support

config TLS_SUPPORT
	bool
	prompt "Enable Thread-local storage (TLS) support" if TOOLCHAINOPTS
	default n
	help
	    Enable Thread-local storage support

config SJLJ_EXCEPTIONS
	bool
	prompt "Use setjump()/longjump() exceptions" if TOOLCHAINOPTS
	default n
	help
	    Use old setjump()/longjump() exceptions instead of the newer
	    frame unwinding exceptions handling routines.  Warning: increases
	    code size and runtime memory usage.

config INSTALL_LIBGCJ
	bool
	depends on !GCC_VERSION_LLVM
	prompt "Build/install java compiler and GNU classpath ?" if TOOLCHAINOPTS
	default n
	help
	    Build/install java compiler and GNU classpath ?


config INSTALL_GFORTRAN
	bool
	prompt "Build/install fortran compiler?" if TOOLCHAINOPTS
	default n
	help
	    Build/install GNU fortran compiler ?
```
