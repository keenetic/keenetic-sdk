## package/kernel/mt7992/Config.in
```kconfig
if PACKAGE_kmod-mt7992

choice
	prompt "SKU type"

	config MTK_WIFI7_SKU_BE19000
		bool "BE19000 (3-adie, 2+5+6)"
	config MTK_WIFI7_SKU_BE13500
		bool "BE13500 (2-adie, 2+5+6)"
	config MTK_WIFI7_SKU_BE13000
		bool "BE13000 (3-adie, 2+5+5)"
	config MTK_WIFI7_SKU_BE7200
		bool "BE7200"
	config MTK_WIFI7_SKU_BE6500
		bool "BE6500"
	config MTK_WIFI7_SKU_BE5040
		bool "BE5040"
	config MTK_WIFI7_SKU_BE3600SDB
		bool "BE3600SDB"
endchoice

endif
```

## package/kernel/mt7993/Config.in
```kconfig
if PACKAGE_kmod-mt7993

choice
	prompt "SKU type"

	config MT7993_SKU_BE19000
		bool "BE19000 (Eagle, 3-adie, 2+5+6)"
	config MT7993_SKU_BE13500
		bool "BE13500 (Eagle, 2-adie, 2+5+6)"
	config MT7993_SKU_BE13000
		bool "BE13000 (Eagle, 3-adie, 2+5+5)"
	config MT7993_SKU_BE7200
		bool "BE7200 (Kite)"
	config MT7993_SKU_BE6500
		bool "BE6500 (Kite)"
	config MT7993_SKU_BE5040
		bool "BE5040 (Kite)"
	config MT7993_SKU_BE3600
		bool "BE3600 (Griffin)"
endchoice

endif
```

## package/kernel/mtk-warp/Config.in
```kconfig
if PACKAGE_kmod-mtk-warp

if TARGET_mt7986 || TARGET_mt7988

config MTK_WARP_FW_WO1
	bool "Use second WO CPU firmware"
	default n

endif

if TARGET_mt7988

config MTK_WARP_FW_WO2
	bool "Use third WO CPU firmware"
	default n

endif

endif
```

## package/private/ndm/Config.in
```kconfig
menu "Configuration"
	depends on PACKAGE_ndm

config NDM_BACKTRACE
	bool "Log a backtrace on a daemon crash"
	select KERNEL_STACKTRACE

config NDM_BACKTRACE_MINIMAL
	depends on NDM_BACKTRACE
	bool "Keep minimal backtrace information"

config NDM_GENERIC_DEBUG
	bool "Generic debug"

config NDM_ASSERTS
	bool "Enable asserts"

config NDM_BUILD_TESTS
	bool "Build tests"

if NDM_GENERIC_DEBUG
	config NDM_TIMER_DEBUG
		bool "Timer debug"

	config NDM_IO_DEBUG
		bool "I/O debug"

	config NDM_CLOUD_DEBUG
		bool "Cloud debug"
endif

config NDM_EVENT_DEBUG
	bool "Event debug"

if NDM_EVENT_DEBUG
	config NDM_EVENT_DBKEY_DEBUG
		bool "Event::DbKey debug"

	config NDM_EVENT_DEVICE_DEBUG
		bool "Event::Device debug"

	config NDM_EVENT_STATS_DEBUG
		bool "Event::Stats debug"

	config NDM_EVENT_TASK_DEBUG
		bool "Event::TaskDone debug"
endif

config NDM_ASAN_DEBUG
	bool "Enable address sanitizer"
	select NDM_BACKTRACE

config NDM_TSAN_DEBUG
	bool "Enable thread sanitizer"
	select NDM_BACKTRACE

config NDM_UBSAN_DEBUG
	bool "Enable undefined behaviour sanitizer"
	select NDM_BACKTRACE

config NDM_DEBUG_SYMBOLS
	bool "Install debug symbol files"
	select NDM_BACKTRACE

if NDM_DEBUG_SYMBOLS
	config NDM_DEBUG_OPTS
		string "Additional debug options"
		default "-ggdb -gdwarf-4 -O0"

	config NDM_DEBUG_NO_LTO
		bool "Disable link time optimization"
		default y
endif

endmenu
```
